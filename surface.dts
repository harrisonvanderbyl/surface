// SPDX-License-Identifier: BSD-3-Clause
/*
 * Copyright (c) 2023 Qualcomm Innovation Center, Inc. All rights reserved.
 * Copyright (c) 2024, Xilin Wu <wuxilin123@gmail.com>
 */

/dts-v1/;

#include "x1p42100.dtsi"
#include "x1p42100-microsoft-surface-pro-12in-1st-ed.dtsi"

/delete-node/ &pmc8380_6;
/delete-node/ &pmc8380_6_thermal;
// // /delete-node/ &pm8010;
// // /delete-node/ &pm8010_thermal;

/ {
	model = "Microsoft Surface Pro 12in 1st Ed with Snapdragon";
	compatible = "microsoft,surface-pro-12in-1st-ed", "qcom,x1p42100";
	chassis-type = "tablet";
};

&gpu {
	status = "okay";

	zap-shader {
		firmware-name = "qcom/x1e80100/ASUSTeK/vivobook-s15/qcdxkmsucpurwa.mbn";
	};
};
